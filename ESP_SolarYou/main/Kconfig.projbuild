## ESP_SolarYou/main/Kconfig.projbuild
```kconfig
menu "SolarYou application"

choice SOLARYOU_RUNTIME_MODE
    prompt "Runtime mode"
    default SOLARYOU_RUNTIME_SENSOR_DASHBOARD_TEST
    help
        Choose whether this build is only reading the real sensors and sending
        dashboard telemetry, or whether it may also command the two servos.

config SOLARYOU_RUNTIME_SENSOR_DASHBOARD_TEST
    bool "Sensor/dashboard test (motor outputs disabled)"
    help
        This is a safe test mode for checking the UART connection. The BNO085
        provides the pitch and roll readings. It also checks the light sensors,
        but a problem with them will not stop the IMU data from being sent.
        The INA219 is optional for now because power data is not connected
        yet. The servos stay off in this mode.

config SOLARYOU_RUNTIME_FULL_CONTROL
    bool "Full integration (motor outputs enabled)"
    help
        Initializes the servos and runs the full light-tracking and PID motor
        control path. This mode should be selected once all hardware
        connections and GPIO assignments have been verified.

endchoice

endmenu
```

## SolarYou_Sensor/components/sensor_service/Kconfig
```kconfig
menu "SolarYou sensor service"

config SOLARYOU_SIMULATION
    bool "Use adjustable Wokwi sensor backends"
    default n
    help
        Build the real sensor_adapter_* API with analog Wokwi inputs in
        place of the BNO085 and INA219 hardware interfaces. The four light
        inputs continue through the production light algorithm. Leave this
        disabled for physical hardware builds.

choice SOLARYOU_VALIDATION_MODE
    prompt "Sensor paths included in the validation application"
    default SOLARYOU_VALIDATION_ALL
    help
        Select which sensor path the standalone validation application owns.
        The normal physical build and combined Wokwi build use all sensors.
        The individual Wokwi builds compile and exercise only one path while
        preserving the same public sensor_adapter_* API.

config SOLARYOU_VALIDATION_ALL
    bool "IMU, light array, and power"

config SOLARYOU_VALIDATION_LIGHT_ONLY
    bool "Four-light array only"

config SOLARYOU_VALIDATION_IMU_ONLY
    bool "IMU only"

config SOLARYOU_VALIDATION_POWER_ONLY
    bool "Power sensor only"

endchoice

endmenu
```
